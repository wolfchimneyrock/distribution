## projects/ROCKNIX/devices/A733/packages/u-boot/sources/configs/rocknix-cubie-a7a_defconfig
```kconfig
CONFIG_ARM=y
CONFIG_ARCH_SUNXI=y
CONFIG_HAS_CUSTOM_SYS_INIT_SP_ADDR=y
CONFIG_CUSTOM_SYS_INIT_SP_ADDR=0x4F000000
CONFIG_DEFAULT_DEVICE_TREE="sun60i-a733-radxa-a7a"
CONFIG_SPL=y
CONFIG_SPL_DM=y
CONFIG_SPL_OF_CONTROL=y
# CONFIG_SPL_DM_I2C is not set
# CONFIG_SPL_DM_PMIC is not set
CONFIG_SPL_MAX_SIZE=0x49000
CONFIG_MACH_SUN60I_A733=y
CONFIG_MMC_SUNXI_SLOT_EXTRA=2
# CONFIG_VIDEO_SUNXI is not set
# CONFIG_SYS_MALLOC_CLEAR_ON_INIT is not set
CONFIG_SPL_LOAD_FIT_ADDRESS=0x47a00000
# CONFIG_SPL_DM_SERIAL is not set
CONFIG_BOOTDELAY=3
CONFIG_SPL_RAM_DEVICE=y
CONFIG_CMD_I2C=y
CONFIG_CMD_SPI=y
# CONFIG_CMD_SF is not set
CONFIG_NET_RANDOM_ETHADDR=y
CONFIG_SYS_I2C_MVTWSI=y
CONFIG_MISC=y
CONFIG_NVMEM=y
CONFIG_SUPPORT_EMMC_BOOT=y
CONFIG_DM_MDIO=y
CONFIG_DM_ETH_PHY=y
CONFIG_DWC_ETH_QOS=y
CONFIG_DWC_ETH_QOS_SUNXI=y
CONFIG_RGMII=y
CONFIG_RMII=y
CONFIG_REGULATOR_AXP=y
CONFIG_USB_EHCI_HCD=y
CONFIG_USB_OHCI_HCD=y
CONFIG_USB_MUSB_GADGET=y
CONFIG_USB_ETH_CDC=y
CONFIG_SPL_STACK_R_MALLOC_SIMPLE_LEN=0x140000
CONFIG_SYS_MMCSD_RAW_MODE_U_BOOT_SECTOR=0x250
CONFIG_PCI=y
CONFIG_NVME_PCI=y
CONFIG_PCIE_SUNXI=y
CONFIG_AW_CADENCE_COMBOPHY=y
CONFIG_CMD_PCI=y
CONFIG_SPI=y
# CONFIG_SPI_FLASH is not set
# CONFIG_DM_SPI_FLASH is not set
CONFIG_WDT=y
CONFIG_WDT_SUNXI=y
CONFIG_WATCHDOG=y
CONFIG_CMD_WDT=y
CONFIG_SYSRESET_PSCI=y
CONFIG_DM_RNG=y
CONFIG_RNG_SUN60I_CE=y
CONFIG_CMD_RNG=y
# CONFIG_CMD_SUNXI_BOOT_ARISC is not set
# CONFIG_WATCHDOG_AUTOSTART is not set
# CONFIG_TOOLS_MKEFICAPSULE is not set
CONFIG_I2C_EEPROM=y
CONFIG_RADXA_ID_EEPROM=y
CONFIG_SYS_I2C_EEPROM_ADDR=0x50
CONFIG_SYS_I2C_EEPROM_ADDR_OVERFLOW=0x7
```
